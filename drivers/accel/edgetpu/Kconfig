## drivers/accel/edgetpu/Kconfig
```kconfig
# SPDX-License-Identifier: GPL-2.0
config DRM_ACCEL_EDGETPU
	tristate "Google Edge TPU (gs201) accelerator (Rust)"
	depends on DRM_ACCEL
	depends on RUST
	depends on ARM64 || COMPILE_TEST
	depends on GSA
	select RUST_DRM_GEM_SHMEM_HELPER
	help
	  Rust DRM compute-accelerator driver for the Google Edge TPU built into
	  the Tensor G2 (gs201) SoC, as found in the Pixel Fold (felix). Reuses the
	  hardware knowledge of Google's out-of-tree edgetpu/rio stack but exposes a
	  clean mainline /dev/accel/accelN interface; the DarwiNN/VII runtime lives
	  in userspace.

	  The secure firmware is authenticated and started by GSA over Trusty; the
	  companion edgetpu_gsa module provides that glue, hence the GSA dependency.

	  If M is selected, the modules are edgetpu and edgetpu_gsa.
```

## drivers/gpu/drm/samsung-felix/Kconfig
```kconfig
# SPDX-License-Identifier: GPL-2.0
config DRM_SAMSUNG_FELIX
	tristate "Samsung DPU for Pixel Fold felix (gs201) outer panel"
	depends on DRM && ARCH_EXYNOS
	select DRM_KMS_HELPER
	select DRM_MIPI_DSI
	select DRM_DISPLAY_HELPER
	select DRM_DISPLAY_DSC_HELPER
	select DRM_GEM_DMA_HELPER
	select DRM_PANEL_BRIDGE
	select VIDEOMODE_HELPERS
	help
	  Grafted AOSP samsung DRM stack (DECON1/DSIM1/DPP) to drive the felix
	  outer/cover panel samsung,ea8182-f10 (command-mode, DSC). Bring-up WIP.
```

## drivers/pmdomain/samsung/Kconfig
```kconfig
# SPDX-License-Identifier: GPL-2.0
if SOC_SAMSUNG

config EXYNOS_PM_DOMAINS
	bool "Exynos PM domains" if COMPILE_TEST
	depends on (ARCH_EXYNOS && PM_GENERIC_DOMAINS) || COMPILE_TEST

config GS201_PM_DOMAINS
	bool "gs201 (Tensor G2) PM domains" if COMPILE_TEST
	depends on (ARCH_EXYNOS && PM_GENERIC_DOMAINS) || COMPILE_TEST
	depends on EXYNOS_PMU
	help
	  Generic power domain support for gs201 (Tensor G2). Same PMU
	  CONFIGURATION/STATUS layout as EXYNOS_PM_DOMAINS, but gs201's PMU is
	  EL3-only, so accesses are mediated by BL31 via the SMC-routed regmap
	  that exynos-pmu.c installs, rather than a direct MMIO writel().

	  Without this nothing powers gs201's SoC domains down: the bootloader
	  leaves them all on, which costs roughly 5C at idle versus stock.

endif
```

## drivers/soc/google/gsa/Kconfig
```kconfig
# SPDX-License-Identifier: GPL-2.0
config GSA
	tristate "Google GSA (Google Security Authenticator) driver"
	depends on TRUSTY
	help
	  Driver for the Google Security Authenticator (GSA/Titan M) coprocessor
	  on Google Tensor (gs101/gs201/zuma) SoCs. Provides firmware image
	  authentication for on-SoC IPs (TPU, AOC, DSP) via an MMIO mailbox and
	  Trusty. Needed to authenticate + start the secure Edge TPU firmware.
```

## drivers/thermal/samsung/Kconfig
```kconfig
# SPDX-License-Identifier: GPL-2.0-only
config EXYNOS_THERMAL
	tristate "Exynos thermal management unit driver"
	depends on THERMAL_OF
	depends on HAS_IOMEM
	default ARCH_EXYNOS
	help
	  If you say yes here you get support for the TMU (Thermal Management
	  Unit) driver for Samsung Exynos series of SoCs. This driver initialises
	  the TMU, reports temperature and handles cooling action if defined.
	  This driver uses the Exynos core thermal APIs and TMU configuration
	  data from the supported SoCs.

config GS201_ACPM_THERMAL
	tristate "Google gs201 ACPM thermal sensor driver"
	depends on THERMAL_OF
	depends on EXYNOS_ACPM_PROTOCOL
	default ARCH_EXYNOS
	help
	  Thermal sensor driver for the Google gs201 (Tensor G2) SoC, whose
	  Thermal Management Unit is read over IPC to the ACPM power-management
	  coprocessor rather than a memory-mapped register block. Registers the
	  TMU sensors with the thermal framework so DT thermal-zones and cooling
	  maps can throttle CPU cpufreq / GPU devfreq under load.

config S2MPG13_SPMIC_THERMAL
	tristate "Google gs201 s2mpg13 sub-PMIC NTC thermal sensor driver"
	depends on THERMAL_OF
	depends on MFD_SEC_CORE
	default ARCH_EXYNOS
	help
	  Thermal sensor driver for the off-die NTC thermistors sampled by the
	  Google gs201 s2mpg13 sub-PMIC METER block (skin, USB, display, GNSS).
	  Reads the low-pass-filtered ADC codes over the sec-acpm "meter" regmap
	  and registers them with the thermal framework so DT thermal-zones such
	  as skin_therm can act on board-surface temperature.
```

## drivers/ufs/host/exynos-gs/Kconfig
```kconfig
# SPDX-License-Identifier: GPL-2.0-only

config SCSI_UFS_EXYNOS_GS
	tristate "EXYNOS UFS Host Controller Driver for Google Tensor (GS) SoCs"
	depends on SCSI_UFSHCD && SCSI_UFSHCD_PLATFORM
	depends on (ARCH_EXYNOS || COMPILE_TEST)
	help
	  Vendor UFS host controller driver for Google Tensor (Tensor G1/gs101,
	  Tensor G2/gs201, Tensor G3/zuma) SoCs, ported from the AOSP downstream
	  Pixel kernel. Use this in preference to SCSI_UFS_EXYNOS for those SoCs:
	  the AOSP driver has working support for HS-Rate-A and HS-Rate-B link
	  startup, while mainline's drivers/ufs/host/ufs-exynos.c gs101 path
	  wedges with dl_err 0x80000002 immediately after PMC.

	  Runtime selection is by DT compatible string. The two drivers cannot
	  bind to the same node simultaneously; ensure your DT uses
	  "google,gs101-ufs" / "google,gs201-ufs" / "google,zuma-ufs" only when
	  this driver is present.

	  If unsure, say N.
```
